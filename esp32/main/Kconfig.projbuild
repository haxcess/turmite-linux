## esp32/main/Kconfig.projbuild
```kconfig
menu "Turmite Waveshare 7B"
config TURMITE_ANTS
    int "Initial ant count"
    range 2 32
    default 3
config TURMITE_DIVISOR
    int "Token-rate divisor"
    range 1 1000
    default 250
config TURMITE_CELL_SIZE
    int "Display pixels per cell (rounded at edges)"
    range 2 16
    default 3
config TURMITE_LIFETIME_SECONDS
    int "Universe lifetime in seconds (0 disables reseeding)"
    range 0 3600
    default 300
config TURMITE_FPS
    int "Maximum rendered frames per second"
    range 1 30
    default 20
endmenu
```

## esp32/sdkconfig.defaults
```kconfig
CONFIG_IDF_TARGET="esp32s3"
CONFIG_ESP_DEFAULT_CPU_FREQ_MHZ_240=y
CONFIG_ESPTOOLPY_FLASHMODE_QIO=y
CONFIG_ESPTOOLPY_FLASHFREQ_80M=y
CONFIG_ESPTOOLPY_FLASHSIZE_16MB=y
CONFIG_SPIRAM=y
CONFIG_SPIRAM_MODE_OCT=y
CONFIG_SPIRAM_SPEED_80M=y
CONFIG_SPIRAM_USE_MALLOC=y
CONFIG_SPIRAM_MALLOC_ALWAYSINTERNAL=16384
CONFIG_SPIRAM_MALLOC_RESERVE_INTERNAL=65536
CONFIG_SPIRAM_FETCH_INSTRUCTIONS=y
CONFIG_SPIRAM_RODATA=y
CONFIG_FREERTOS_HZ=1000
CONFIG_ESP_MAIN_TASK_STACK_SIZE=8192
CONFIG_COMPILER_OPTIMIZATION_PERF=y
CONFIG_PARTITION_TABLE_CUSTOM=y
CONFIG_PARTITION_TABLE_CUSTOM_FILENAME="partitions.csv"
CONFIG_ESP_CONSOLE_UART_DEFAULT=y
```
